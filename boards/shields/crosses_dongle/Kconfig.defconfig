## boards/shields/crosses_dongle/Kconfig.defconfig
```kconfig
if SHIELD_CROSSES_DONGLE

config ZMK_KEYBOARD_NAME
    default "Crosses Dongle"

config ZMK_SPLIT
    default y

config ZMK_SPLIT_ROLE_CENTRAL
    default y

# Two physical halves => the central must explicitly accept two peripheral
# slots. ZMK leaves this symbol with no default; without it, only the half
# that bonds first survives and the other is silently rejected.
config ZMK_SPLIT_BLE_CENTRAL_PERIPHERALS
    default 2

# 2 peripherals + 5 BT host profiles (ZMK convention).
config BT_MAX_CONN
    default 7

config BT_MAX_PAIRED
    default 7

endif
```

## boards/shields/crosses_left_dongle/Kconfig.defconfig
```kconfig
if SHIELD_CROSSES_LEFT_DONGLE

config ZMK_KEYBOARD_NAME
    default "Crosses L"

# Override the upstream shield's role: left becomes a non-central peripheral
# when the dongle is the central.
config ZMK_SPLIT_ROLE_CENTRAL
    default n

endif
```

## boards/shields/crosses_left_dongle/Kconfig.shield
```kconfig
config SHIELD_CROSSES_LEFT_DONGLE
    def_bool $(shields_list_contains,crosses_left_dongle)
```

## boards/shields/crosses_right_dongle/Kconfig.defconfig
```kconfig
if SHIELD_CROSSES_RIGHT_DONGLE

config ZMK_KEYBOARD_NAME
    default "Crosses R"

# Override the upstream right shield's central role.
config ZMK_SPLIT_ROLE_CENTRAL
    default n

endif
```

## boards/shields/crosses_right_dongle/Kconfig.shield
```kconfig
config SHIELD_CROSSES_RIGHT_DONGLE
    def_bool $(shields_list_contains,crosses_right_dongle)
```
