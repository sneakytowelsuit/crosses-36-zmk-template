/*
 * Left half as a pure peripheral under the dongle.
 *
 * The upstream crosses_left overlay already publishes its trackball through
 * `trackball_peripheral_split` (reg=0) with the scroll-mapper chain, so all
 * we need to do here is enable it. SHIELD_CROSSES_LEFT being def_bool'd on
 * pulls in the upstream overlay automatically.
 */

/ {
    chosen { zmk,physical-layout = &gggw_crosses_36_layout; };
};

&trackball_peripheral_split {
    status = "okay";
};

/*
 * Force the left half's matrix transform to col-offset=0. Each peripheral
 * runs its OWN matrix transform locally and forwards the computed keymap
 * position (an integer) to the central — the central does not re-offset.
 * Upstream `crosses_left.overlay` doesn't set col-offset explicitly; setting
 * it here removes any ambiguity and guarantees left positions don't collide
 * with the right's col-offset=6 region.
 */
&thirty_six_transform {
    col-offset = <0>;
};
